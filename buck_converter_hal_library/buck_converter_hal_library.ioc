# file: buck_converter_hal_library.ioc
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Mcu.Family=STM32F4
Mcu.Name=STM32F401R(D-E)Tx
Mcu.Package=LQFP64
NVIC.PriorityGroup=NVIC_PRIORITYGROUP_4
PA13.Mode=Serial_Wire
PA13.Signal=SYS_JTMS-SWDIO
PA14.Mode=Serial_Wire
PA14.Signal=SYS_JTCK-SWCLK
PH0\ -\ OSC_IN.Mode=HSE-External-Oscillator
PH0\ -\ OSC_IN.Signal=RCC_OSC_IN
PH1\ -\ OSC_OUT.Mode=HSE-External-Oscillator
PH1\ -\ OSC_OUT.Signal=RCC_OSC_OUT
ProjectManager.HeapSize=0x200
ProjectManager.StackSize=0x400
ProjectManager.TargetToolchain=STM32CubeIDE
RCC.48MHZClocksFreq_Value=42000000
RCC.AHBFreq_Value=84000000
RCC.APB1CLKDivider=RCC_HCLK_DIV2
RCC.APB1Freq_Value=42000000
RCC.APB1TimFreq_Value=84000000
RCC.APB2Freq_Value=84000000
RCC.APB2TimFreq_Value=84000000
RCC.CortexFreq_Value=84000000
RCC.HCLKFreq_Value=84000000
RCC.HSE_VALUE=25000000
RCC.HSI_VALUE=16000000
RCC.LSE_VALUE=32768
RCC.PLLM=8
RCC.PLLN=84
RCC.SYSCLKFreq_VALUE=84000000
RCC.SYSCLKSource=RCC_SYSCLKSOURCE_PLLCLK
RCC.VCOOutputFreq_Value=168000000
board=custom

// file: Core/Src/main.c
/* USER CODE BEGIN Header */
/**
  ******************************************************************************
  * @file           : main.c
  * @brief          : Main program body
  ******************************************************************************
  * @attention
  *
  * Copyright (c) 2025 STMicroelectronics.
  * All rights reserved.
  *
  * This software is licensed under terms that can be found in the LICENSE file
  * in the root directory of this software component.
  * If no LICENSE file comes with this software, it is provided AS-IS.
  *
  ******************************************************************************
  */
/* USER CODE END Header */
#include "main.h"
#include "Defines.h"
#include "adc_reader.h"
#include "sensor_converter.h"
#include "control_pid_regulator.h"
#include "pwm_output_driver.h"
#include "can_transmitter.h"

void SystemClock_Config(void);
static void MX_GPIO_Init(void);

/* USER CODE BEGIN 0 */
/* USER CODE BEGIN PV */

typedef enum {
    SYS_STEP_READ_ADC = 0,
    SYS_STEP_CONVERT,
    SYS_STEP_CHECK_FAULT,
    SYS_STEP_UPDATE_PARAMS,
    SYS_STEP_PID,
    SYS_STEP_PWM
} SystemStep_t;

SystemState_t g_system;
PID_Controller_t vout_pid;
SystemCANState_t system_can_status = SYS_STATE_IDLE;
uint32_t can_last_time = 0;

SystemStep_t current_step = SYS_STEP_READ_ADC;

float test_pwm_duty = 0.0f;

//pid
/* PID ayarları  */
float pid_Kp = 0.8f;
float pid_Ki = 20.0f;
float pid_Kd = 0.5f;
float pid_dt = 0.0001f;

//can
float can_setpoint = 24.0f;
float can_kp = 0.8f;
float can_ki = 20.0f;
float can_kd = 0.0f;
uint8_t can_enable = 1;

/* USER CODE END PV */

/* USER CODE END 0 */

int main(void)
{

  /* MCU Configuration--------------------------------------------------------*/

  /* Reset of all peripherals, Initializes the Flash interface and the Systick. */
  HAL_Init();

  /* Configure the system clock */
  SystemClock_Config();

  /* Initialize all configured peripherals */
  MX_GPIO_Init();
  /* USER CODE BEGIN 2 */
  // DMA buffer (DMA modunda kullanılır)
  ADC_Reader_Init_DMA();  // Başlat (DMA & scan mode)
  PID_Init(&vout_pid, pid_Kp, pid_Ki, pid_Kd, pid_dt, 0.0f, 100.0f);
  PWM_Output_Init();
  /* USER CODE END 2 */

  /* Infinite loop */
  /* USER CODE BEGIN WHILE */
  while (1)
  {
      switch (current_step)
      {
          case SYS_STEP_READ_ADC:
              // DMA buffer'dan ADC verilerini oku
              adc_dma_buffer[0];  // VOUT
              adc_dma_buffer[1];  // IOUT
              current_step = SYS_STEP_CONVERT;
              break;

          case SYS_STEP_CONVERT:
              g_system.vout = Sensor_ConvertToVoltage(adc_dma_buffer[0]);
              g_system.iout = Sensor_ConvertToCurrent(adc_dma_buffer[1]);
              current_step = SYS_STEP_CHECK_FAULT;
              break;
          case SYS_STEP_CHECK_FAULT:
              g_system.overcurrent = (g_system.iout >= 10.0f) ? 1 : 0;

              // Sistem durumu belirle
              if (g_system.overcurrent) {
                  system_can_status = SYS_STATE_OVERCURRENT;
              } else if (can_enable) {
                  system_can_status = SYS_STATE_RUNNING;
              } else {
                  system_can_status = SYS_STATE_IDLE;
              }

              current_step = SYS_STEP_UPDATE_PARAMS;
              break;

              break;

          case SYS_STEP_UPDATE_PARAMS:
              g_system.vout_target = can_setpoint;
              pid_Kp = can_kp;
              pid_Ki = can_ki;
              pid_Kd = can_kd;
              current_step = SYS_STEP_PID;
              break;

          case SYS_STEP_PID:
              if (can_enable)
              {
                  float duty = PID_Update(&vout_pid, g_system.vout_target, g_system.vout);
                  g_system.pwm_duty = duty;
              }
              else
              {
                  g_system.pwm_duty = 0.0f;
              }
              current_step = SYS_STEP_PWM;
              break;

          case SYS_STEP_PWM:
              PWM_Output_SetDuty(g_system.pwm_duty);
              current_step = SYS_STEP_READ_ADC;  // döngüyü başa al
              break;

          default:
              current_step = SYS_STEP_READ_ADC;
              break;
      }

      // 100ms'de bir CAN mesajı gönder
      if (HAL_GetTick() - can_last_time >= 100) {
          CAN_Transmitter_SendTelemetry(&g_system, system_can_status);
          can_last_time = HAL_GetTick();
      }

  }

  /* USER CODE END 3 */
}

void SystemClock_Config(void)
{
  RCC_OscInitTypeDef RCC_OscInitStruct = {0};
  RCC_ClkInitTypeDef RCC_ClkInitStruct = {0};

  /** Configure the main internal regulator output voltage
  */
  __HAL_RCC_PWR_CLK_ENABLE();
  __HAL_PWR_VOLTAGESCALING_CONFIG(PWR_REGULATOR_VOLTAGE_SCALE2);

  /** Initializes the RCC Oscillators according to the specified parameters
  * in the RCC_OscInitTypeDef structure.
  */
  RCC_OscInitStruct.OscillatorType = RCC_OSCILLATORTYPE_HSI;
  RCC_OscInitStruct.HSIState = RCC_HSI_ON;
  RCC_OscInitStruct.HSICalibrationValue = RCC_HSICALIBRATION_DEFAULT;
  RCC_OscInitStruct.PLL.PLLState = RCC_PLL_ON;
  RCC_OscInitStruct.PLL.PLLSource = RCC_PLLSOURCE_HSI;
  RCC_OscInitStruct.PLL.PLLM = 8;
  RCC_OscInitStruct.PLL.PLLN = 84;
  RCC_OscInitStruct.PLL.PLLP = RCC_PLLP_DIV2;
  RCC_OscInitStruct.PLL.PLLQ = 4;
  if (HAL_RCC_OscConfig(&RCC_OscInitStruct) != HAL_OK)
  {
    Error_Handler();
  }

  /** Initializes the CPU, AHB and APB buses clocks
  */
  RCC_ClkInitStruct.ClockType = RCC_CLOCKTYPE_HCLK|RCC_CLOCKTYPE_SYSCLK
                              |RCC_CLOCKTYPE_PCLK1|RCC_CLOCKTYPE_PCLK2;
  RCC_ClkInitStruct.SYSCLKSource = RCC_SYSCLKSOURCE_PLLCLK;
  RCC_ClkInitStruct.AHBCLKDivider = RCC_SYSCLK_DIV1;
  RCC_ClkInitStruct.APB1CLKDivider = RCC_HCLK_DIV2;
  RCC_ClkInitStruct.APB2CLKDivider = RCC_HCLK_DIV1;

  if (HAL_RCC_ClockConfig(&RCC_ClkInitStruct, FLASH_LATENCY_2) != HAL_OK)
  {
    Error_Handler();
  }
}

static void MX_GPIO_Init(void)
{

  /* GPIO Ports Clock Enable */
  __HAL_RCC_GPIOH_CLK_ENABLE();
  __HAL_RCC_GPIOA_CLK_ENABLE();

}

void Error_Handler(void)
{
  __disable_irq();
  while (1)
  {
  }
}
