VERSION ""

NS_ :

BS_:

BU_:
VAL_TABLE_ Status_Value_Table 5 "FAULT" 3 "OVERCURRENT" 2 "ERROR" 1 "RUNNING" 0 "IDLE" 4 "ADC_FAIL" ;

BO_ 1393 DEVICE_STATUS: 8 Vector__XXX
 SG_ Iin : 63|16@1+ (0.01,0) [0|15] "A" Vector__XXX
 SG_ Vout : 48|16@1+ (0.01,0) [0|30] "V" Vector__XXX
 SG_ Temp : 32|8@1- (1,0) [-40|125] "°C" Vector__XXX
 SG_ Status : 24|8@1+ (1,0) [0|5] "" Vector__XXX
 SG_ Iout : 16|8@1+ (0.1,0) [0|25] "A" Vector__XXX
 SG_ Vin : 0|16@1+ (0.01,0) [0|60] "V" Vector__XXX

VAL_ 1393 Status 5 "FAULT" 3 "OVERCURRENT" 2 "ERROR" 1 "RUNNING
" 0 "IDLE" 4 "ADC_FAIL" ;
