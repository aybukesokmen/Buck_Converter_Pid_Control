VERSION ""

NS_ :

BS_:

BU_: BuckController PC_Tool

VAL_TABLE_ Status_Enum 0 "IDLE" 1 "RUNNING" 2 "ERROR" 3 "OVERCURRENT" 4 "FAULT" 5 "ADC_FAIL";

BO_ 1365 DEVICE_STATUS: 8 BuckController
 SG_ Vin   : 0|16@1+ (0.01,0) [0|60] "V"  PC_Tool
 SG_ Iin   : 16|16@1+ (0.01,0) [0|20] "A"  PC_Tool
 SG_ Vout  : 32|16@1+ (0.01,0) [0|30] "V"  PC_Tool
 SG_ Iout  : 48|8@1+ (0.1,0)  [0|10] "A"  PC_Tool
 SG_ Temp  : 56|8@1+ (1,0)   [-40|125] "°C" PC_Tool
 SG_ Status : 64|8@1+ (1,0)  [0|5] ""  PC_Tool

CM_ BO_ 1365 "Telemetry message including converter status, voltages, current, temperature and error state";
CM_ SG_ 1365 Vin "Input voltage";
CM_ SG_ 1365 Iin "Input current";
CM_ SG_ 1365 Vout "Output voltage";
CM_ SG_ 1365 Iout "Output current";
CM_ SG_ 1365 Temp "System temperature";
CM_ SG_ 1365 Status "System status";
